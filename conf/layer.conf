## conf/layer.conf
```bitbake
# We have a conf and classes directory, add to BBPATH
BBPATH .= ":${LAYERDIR}"

# We have recipes-* directories, add to BBFILES
BBFILES += "${LAYERDIR}/recipes-*/*/*.bb \
            ${LAYERDIR}/recipes-*/*/*.bbappend"

BBFILE_COLLECTIONS += "busybox-rtcwake"
BBFILE_PATTERN_busybox-rtcwake = "^${LAYERDIR}/"
BBFILE_PRIORITY_busybox-rtcwake = "5"
```
